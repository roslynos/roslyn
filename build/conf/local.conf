## build/conf/local.conf
```bitbake
# Machine Selection
MACHINE ?= "raspberrypi3-64"

# The distribution setting controls which policy settings are used as defaults.
DISTRO ?= "roslynos"

# Package Management configuration
PACKAGE_CLASSES ?= "package_ipk"

# The EXTRA_IMAGE_FEATURES variable allows extra packages to be added to the generated images.
EXTRA_IMAGE_FEATURES ?= "debug-tweaks"

# Additional image features
USER_CLASSES ?= "buildstats"

# Removes work files after the openembedded build system has finished.
INHERIT += "rm_work"

# Auto start using the PR service
#PRSERV_HOST = "localhost:0"

# Eliminates udev and glib features
# VIRTUAL-RUNTIME_dev_manager = ""

# Interactive shell configuration
PATCHRESOLVE = "noop"

# Disk Space Monitoring during the build
BB_DISKMON_DIRS ??= "\
    STOPTASKS,${TMPDIR},1G,100K \
    STOPTASKS,${DL_DIR},1G,100K \
    STOPTASKS,${SSTATE_DIR},1G,100K \
    STOPTASKS,/tmp,100M,100K \
    HALT,${TMPDIR},100M,1K \
    HALT,${DL_DIR},100M,1K \
    HALT,${SSTATE_DIR},100M,1K \
    HALT,/tmp,10M,1K"

# configuration version
CONF_VERSION = "2"
```
